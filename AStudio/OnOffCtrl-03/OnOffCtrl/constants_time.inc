/*
 * constants_time.asm
 *
 *  Created: 30.10.2019 13:46:15
 *   Author: vp
 */ 
;====================================================================
;                       CONSTANTS
;====================================================================
.CSEG
;частота TCNT0 = 2.34 - 2.48, а с учетом программного делителя fdel = 2,
; Ftimer = 1.17 - 1.24 кГц => параметры времени программных таймеров необходимо увеличить, примерно, на 1.24.
.equ key_snd_time = 124 ;= 100 msec - время звукового импульса нажатия кнопки
.equ err_snd_time = 1240 ;= 1000 msec - время звукового импульса нажатия кнопки
.equ led_light_time = 620 ;= 500 msec - время светового импульса
.equ time_wait = 4960 ;= 4000 msec - время ожидания вкл/откл БП
.equ key_wait = 50 ;= 40 msec - время дребезга кнопки
