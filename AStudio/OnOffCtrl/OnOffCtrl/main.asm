;
; OnOffCtrl.asm
; version 0.1
; Created: 08.10.2019 18:17:14
; Author : vp
;
;====================================================================
;====================================================================
;                       DEFINITIONS
;====================================================================
;.set _DEBUG_ = 1

.INCLUDE "macros.inc"
.INCLUDE "constants_time.inc"
.INCLUDE "var-offonctrl.inc"

.CSEG              
.ORG 0
;===========================================================================================
;                           Сброс и векторы прерываний
;===========================================================================================
	rjmp start
	rjmp _int0
	rjmp pcint
	rjmp tim_ovo
	rjmp ee_rdy
	rjmp ana_comp
	rjmp tim_compa
	rjmp tim_compb
	rjmp watch_dog
	rjmp ADConv


.INCLUDE "calls.asm"

;===========================================================================================
;                            Инициализация программы
;===========================================================================================
start:
	ldi r16, low(RAMEND)
	out SPL, r16
    ;=====================================================
	;           настройка портов ввода/вывода
    ;=====================================================
	ldi r16, 0x19   ; b00011001
    out ddrB, r16	; B1,B2,B5 - входы, B0,B3,B4 - выходы
	ldi r16, 0x1A	; b00011010 B1 с подтяжкой,B2,B5-без;B0=0,B3,B4==1
	out portB, r16
    ;=====================================================
	;     настройка предделителя тактового генератора
    ;=====================================================
.ifdef _DEBUG_
	in  r16, clkpr	; контроль регистра до операции
.endif
	ldi r16, 0x80
	ldi r17, 0x01   ; Кдел предделителя тактового генератора = 2
	out clkpr, r16
	out clkpr, r17
.ifdef _DEBUG_
	in  r16, clkpr  ; контроль регистра после операции
.endif
    ;=====================================================
    ;               настройка таймера
    ;=====================================================
	clr r16
	out timsk0, r16	; прерывания от таймера T0 запрещены
	out tccr0a, r16	; режим T0 - normal, OCR0A и OCR0B отключены от выводов 
	ldi r16, 0xff	;
	out ocr0a, r16
	ldi r16, 0x02   ; Кдел предделителя T0 = 8
	out tccr0b, r16	
    ;=====================================================
    ;               инициализация памяти
    ;=====================================================
    clr r18
    sts fdel, r18    ; сброс программного делителя частоты прерывания TCNT0
    sts state, r18   ; установка нулевого состояния - БП отключен
    sts mode, r18    ; установка режима ожидания нажатия кнопки для включения БП
    ;sts error, r18   ; установка кода ошибок с состояние "нет ошибки"
    sts button, r18  ; сброс события нажатия кнопки
    sts key_state, r18  ; сброс состояния обработчика нажатия кнопки
    sts pwr_state, r18  ; сброс состояния входа контроля напряжения
    sts pwr_volatile, r18  ; сброс состояния обработчика контроля напряжения
.ifdef _DEBUG_
    sts shatter_count, r18 ; инициал. счетчика процесса дребезга контактов от кнопки (для отладки)
    sts shatter2_count, r18 ; инициал. счетчика процесса дребезга контактов от контроля напряжения (для отладки)
.endif
    ;sts snd_err_stat, r18 ; инициал. статуса
    ;sts snd_err_mode, r18 ; режим выключен
    ;=====================================================
    ;           инициализация таймеров: отключение
    ;=====================================================
     sts timer01, r18
     sts timer02, r18
     sts timer03, r18
     sts timer0Z, r18
    ;=====================================================
    ;       задается прерывание переполнения TCNT0
    ;=====================================================
    ldi r16, 0x02       ; 0x02 - бит прерывания от переполнения TCNT0
    in r17, timsk0
    or r17, r16
    out timsk0, r17     ; устанавливается разрешение прерывания от переполнения TCNT0
    ;=====================================================
    ;   задается номер прерывания PCINT2
    ;=====================================================
    _SET_NUM_PCIE_ r16, r17, 0x04   ; 0x04 - задается номер прерывания PCINT2
    ;=====================================================
    ; задается режим внешнего прерывания INT0 
    ; 0 - по низкому уровню
    ; 1 - при любом изменении 
    ; 2 - по спаду
    ; 3 - по фронту
    ;=====================================================
    _MODE_INT0_ r16, r17, 1   
    ;=========================================================
    ; задается разрешение от внешнего прерывания INT0 и PCIE
    ;=========================================================
    _EN_EXTINT_ r16, r17, 0x60  ; 0x40 - бит прерывания от INT0 + 0x20 - бит прерывания от PCIE
    ;=====================================================
    ;       Сброс флагов прерываний от таймера
    ;=====================================================
    clr r16
    out tifr0, r16
    sei
;===========================================================================================
;                            Основная программа
;===========================================================================================
main_loop:
    ;=====================================================
    ;              Определение состояния системы
    ;=====================================================
    lds r19, state
    cpi r19, 1
    breq main_loop_state1
    rcall main_state0
    rjmp main_loop_continue

main_loop_state1:
    rcall main_state1

main_loop_continue:    
    rcall main_loop_indication
    rjmp main_loop

;===========================================================================================
;                           Определение попдпрограмм
;===========================================================================================
    ;=====================================================
    ;          ПП   Обработка состояния 0 - "Отключен"
    ;=====================================================
main_state0:
    lds r19, mode
    cpi r19, 1
    breq main_loop_state0_mode1
    rcall main_state0_mode0
    rjmp main_state0_return

main_loop_state0_mode1:
    rcall main_state0_mode1

main_state0_return:
    ret

    ;=====================================================
    ;          ПП   Обработка состояния 0 - режим 0
    ;=====================================================
main_state0_mode0:
    rcall key_process   ; вызов обработчика события от кнопки
    lds r16, button
    cpi r16, 1  ; проверка события от кнопки
    brne main_state0_mode0_return  ; если 0
    ; если 1
    ;=====================================================
    ; Кнопка была нажата и отпущена. Переход в режим 1
    ;=====================================================
;main_state0_mode0_set_mode1:
    clr r16
    sts button, r16 ; сброс события от кнопки
    _OCR0A_On_ r16, r17 ; включить звук - звуковое подтверждение нажатия кнопки
    ldi r18, 1    ; запустить таймеры сразу после инициализации
    ; запуск таймера звука - звуковое подтверждение нажатия кнопки
    ; и запуск таймера ожидания включения БП
    rcall set_sound_wait_timers
    ;Включение БП
    in r16, PinB
    ldi r17, 0xf7
    and r16, r17
    out portB, r16  ; установить в 0 сигнал PS_ON БП
    ; установить режим 1 состояния 0
    ldi r16, 1
    sts mode, r16
main_state0_mode0_return:
    ret

    ;=====================================================
    ;          ПП   Обработка состояния 0 - режим 1
    ;=====================================================
main_state0_mode1:
    rcall  pwr_ctrl_process  ; вызов пп контроля сигнала PW_OK
    ; проверка включения БП
    lds r16, pwr_state
    cpi r16, 1                          ; 1 - сигнал PW_OK присутствует
    brne  main_state0_mode1_off         ; 0 - отсутствует
main_state0_mode1_on:
    ; БП включился
    ; установка режима 0 состояния 1
    clr r16
    sts mode, r16   ; установить режим 0 состояния 1
    inc r16
    sts state, r16  ; установить состояние 1
    ; управление светодиодом индикации включения/отключения БП
    ldi r16, 0xef
    in r17, pinB
    and r17, r16
    out portB, r17  ; включить светодиод
    ldi r18, 0
    sts timer02, r18 ; отключить таймер мигания светодиода 
    sts timer03, r18 ; отключить таймер ожидания включения
    rjmp main_state0_mode1_return
main_state0_mode1_off:
    ; ожидание включения БП
    lds r16, timer03
    cpi r16, 0
    brne main_state0_mode1_return
    ; БП не включился - сбой включения
    sts mode, r16   ; установить режим 0 состояния 0
    in r16, PinB
    ldi r17, 0x08
    or r16, r17
    out portB, r16  ; установить в 0 сигнал PS_ON БП
    rcall set_power_error
main_state0_mode1_return:
    ret

;==============================================================================

    ;=====================================================
    ;          ПП   Обработка состояния 1 - "Включен"
    ;=====================================================
main_state1:
    lds r19, mode
    cpi r19, 1
    breq main_loop_state1_mode1
    rcall main_state1_mode0
    rjmp main_state1_return

main_loop_state1_mode1:
    rcall main_state1_mode1

main_state1_return:
    ret

    ;=====================================================
    ;          ПП   Обработка состояния 1 - режим 0
    ;=====================================================
main_state1_mode0:
    rcall  pwr_ctrl_process  ; вызов пп контроля сигнала PW_OK
    ; проверка работы БП
    lds r16, pwr_state
    cpi r16, 1                          ; 1 - сигнал PW_OK присутствует
    brne  main_state1_mode0_off         ; 0 - отсутствует
    rcall key_process   ; вызов обработчика события от кнопки
    lds r16, button
    cpi r16, 1  ; проверка наличия события от кнопки
    brne main_state1_mode0_return  ; если 0
    ; если 1
    ;=====================================================
    ; Кнопка была нажата и отпущена. Переход в режим 1
    ;=====================================================
    clr r16
    sts button, r16 ; сброс события кнопки
    _OCR0A_On_ r16, r17 ; включить звук - звуковое подтверждение нажатия кнопки
    ldi r18, 1    ; запустить таймеры сразу после инициализации
    ; запуск таймера звука - звуковое подтверждение нажатия кнопки
    ; и запуск таймера ожидания отключения БП
    rcall set_sound_wait_timers
    ;Отключение БП
main_state1_mode0_set_mode1:
    in r16, PinB
    ldi r17, 0x08
    or r16, r17
    out portB, r16  ; установить в 0 сигнал PS_ON БП
    ; установить режим 1 состояния 1
    ldi r16, 1
    sts mode, r16
    rjmp main_state1_mode0_return
main_state1_mode0_off:
    ; БП самопроизвольно отключился
    rcall set_power_error
    rjmp main_state1_mode0_set_mode1
main_state1_mode0_return:
    ret

    ;=====================================================
    ;          ПП   Обработка состояния 1 - режим 1
    ;=====================================================
main_state1_mode1:
    rcall  pwr_ctrl_process  ; вызов пп контроля сигнала PW_OK
    ; проверка отключения БП
    lds r16, pwr_state
    cpi r16, 0                          ; 0 - сигнал PW_OK отсутствует
    brne  main_state1_mode1_on          ; 1 - присутствует
main_state1_mode1_off:
    ; БП отключился
    ; установка режима 0 состояния 0
    clr r16
    sts mode, r16   ; установить режим 0 состояния 0
    sts state, r16  ; установить состояние 0
    ; управление светодиодом индикации включения/отключения БП
    ldi r16, 0xef
    in r17, pinB
    and r17, r16
    out portB, r17  ; отключить светодиод
    rjmp main_state1_mode1_return
main_state1_mode1_on:
    ; ожидание отключения БП
    lds r16, timer03
    cpi r16, 0
    brne main_state1_mode1_return
    ; БП не отключился - сбой отключения
    rcall set_power_error
    rjmp main_state1_mode1_off
main_state1_mode1_return:
    ret

;==============================================================================

    ;=====================================================
    ;                ПП  Модель индикации
    ;=====================================================
main_loop_indication:
    lds r16, timer01
    tst r16
    brne main_loop_indication_continue
	_OCR0A_Off_ r16, r17    ; отключить звук
main_loop_indication_continue:
    lds r16, state
    cpi r16, 0
    brne main_loop_indication_return
    ; индикация нулевого состояния сетодиодом
    lds r16, timer02
    tst r16
    brne main_loop_indication_return
    ; управление светодиодом индикации включения/отключения БП
    ldi XL, LOW(timer02)
    ldi r16, LOW(led_light_time)
    ldi r17, HIGH(led_light_time)
    ldi r18, 1
    rcall _set_timer_proc_
    ldi r16, 0x10
    in r17, pinB
    eor r17, r16
    out portB, r17
    
main_loop_indication_return:
    ret

;===========================================================================================
;                            Обработчики прерываний
;===========================================================================================
tim_ovo: 
;=========================================================
;     Прерывание от переполнения таймера T0
;   прерывание реализует логику программных таймеров
;=========================================================
    ; Сохранение регистров в стеке
    push r16
    in r16, sreg
    push r16
    push YL
    push YH
    push XL
    push r24
    push r25
    ;=====================================================
    ;               делитель частоты на 2
    ;=====================================================
    ldi YL, low(fdel)   ; указать адрес на Кдел частоты
    clr YH
    ld XL, Y+   ; загрузить значение Кдел. Y указывает на 1-й байт 1-ой структуры таймеров - состояние 1-ого таймера.
    tst XL      ; проверка четности цикла
    breq tim_ovo_return   ; если 0 - пропуск счета, цикл четный
    ;=====================================================
    ;           Цикл проверки и работы всех таймеров
    ;=====================================================
    ldi XL, LOW( timer0Z)   ; загрузить мл. байт адреса структуры timer0Z - последняя запись таймеров
    inc XL  ; +1 для того чтобы сделать XL заведомо больше адреса timer0Z и операцию brlt не дополнять операцией breq
tim_ovo_repeat:
    ld r24, Y   ; загрузить состояние текущего таймера
    tst r24
    breq tim_ovo_next ; если 0 - текущий таймер не включен
    ldd r24, Y+1    ; загрузка значение текущего таймера - мл. байт
    ldd r25, Y+2    ; загрузка значение текущего таймера - ст. байт
    sbiw r24, 1     ; уменьшение значения текущего таймера
    std Y+1, r24    ; сохранение значения текущего таймера - мл. байт
    std Y+2, r25    ; сохранение значения текущего таймера - ст. байт
    or r24, r25     ; проверка на 0
    brne tim_ovo_next
    st Y, r24       ; сбросить состояние текущего таймера в 0 (не активный)
tim_ovo_next:
    adiw Y, 3   ; установить адрес на следующую структуру таймера
    cp YL, XL   ; проверить на конец таблицы таймеров. здесь XL > адреса timer0Z на 1 (timer0Z - последняя структура таймеров) 
    brlt tim_ovo_repeat   ; если это не конец, то перейти к следующей записи.
    ;breq tim_ovo_repeat
    ;=====================================================
    ;           Завешение обработки прерывания
    ;=====================================================
tim_ovo_return:
    lds r24, fdel
    ldi r25, 1
    eor r24, r25
    sts fdel, r24
    ; восстановление регистров из стека
    pop r25
    pop r24
    pop XL
    pop YH
    pop YL
    pop r16
    out sreg, r16
    pop r16
    
	reti


_int0: 
;=========================================================
;  Прерывание по INT0 - обработка события от кнопки
;        Включение или отключение устройства
;=========================================================
    ; Сохранение регистров в стеке
    push r16
    in r16, sreg
    push r16
    push r17

    ;=========================================================
    ;     key_state - состояние обработчика нажатия кнопки
    ;     0 - ожидание - начальное значение - уст. обработчик key_process;
    ;     1 - произошло изменение состояния входа INT0 - уст. здесь
    ;     2 - обработка дребезга котактов - уст. обработчик key_process;
    ;=========================================================
    lds r16, key_state
    ldi r16, 1
    sts key_state, r16
    ;=========================================================
    ;       задается запрет от внешнего прерывания INT0
    ;=========================================================
;_int0_disable_:
    _DIS_EXTINT_ r16, r17, 0x40  ; 0x40 - бит прерывания от INT0
    ; восстановление регистров из стека
    pop r17
    pop r16
    out sreg, r16
    pop r16
    
	reti

pcint: 
;=========================================================
;         Прерывание по PCIE2 - обработка любого 
;             изменения состояния входа B2
;       Слежение за контрольным сигналом устройства
;=========================================================
    ; Сохранение регистров в стеке
    push r16
    in r16, sreg
    push r16
    push r17
   
    ; Пока считаю, что от напряжения питания дребезга нет, т.к. на нем емкостная нагрузка
    ldi r17, 1
    sts pwr_volatile, r17
    ;=========================================================
    ;       задается запрет от внешнего прерывания PCIE2
    ;=========================================================
;_pcint_disable_:
    _DIS_EXTINT_ r16, r17, 0x20  ; 0x20 - бит прерывания от PCIE

    ; восстановление регистров из стека
    pop r17
    pop r16
    out sreg, r16
    pop r16
    
	reti

ee_rdy: 
ana_comp:
tim_compa: 
tim_compb: 
watch_dog: 
ADConv: 
reti