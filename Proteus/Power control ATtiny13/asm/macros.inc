/*
 * macros.asm
 *
 *  Created: 30.10.2019 13:35:50
 *   Author: vp
 */ 
;==================================================================
;                   макрос _SET_TIMER_
;==================================================================
;   Задает время исполнения указанному таймеру
; с возможностью отложенного или немедленного исполнения таймера.
; при условии заданному разрешению прерывания от переполнения TCNT0
; и общему разрешению прерываний
;==================================================================
.MACRO _SET_TIMER_ 
; Описание параметров макроса
;@0 - имя структуры таймера (например - timer01), 
;@1 - имя константы времени работы таймера (например - key_snd_time), 
;@2 - регистр РОН указатель на @0 (например - X), 
;@3 регистр РОН мл. байта @1 (например - r16),  
;@4 регистр РОН ст. байта @1 (например - r17),  
;@5 регистр РОН управления (например - r18 == 0 или != 0): 
;   == 0 - запрет немедленного выполнения таймера; 
;   != 0 - немедленный запуск таймера с новыми параметрами
;==================================================================
    ldi @2L, LOW(@0)  ; указать адрес в области таймеров на требуемый таймер
    ldi @3, LOW(@1)   ; загрузить мл. байт константы параметра таймера
    ldi @4, HIGH(@1)  ; загрузить ст. байт константы параметра таймера
    tst @5
    brne PC+7     ;brne _set_timer_start
    ;=====================================================
    ;   иницирование нового таймера со сбросом старого 
    ;=====================================================
    cli
    st @2+, @5    ; обнулить флаг таймера - запрет немедленного выполнения таймера
    st @2+, @3    ; инициализировать мл. байт значения таймера
    st @2,  @4     ; инициализировать ст. байт значения таймера
    sei
    rjmp PC+7     ;rjmp _set_timer_return
    ;=====================================================
    ;           иницирование нового таймера 
    ;        вместо уже отработавшего старого 
    ;=====================================================
;_set_timer_start:
    adiw @2, 3
    cli
    st -@2, @4    ; инициализировать ст. байт значения таймера 
    st -@2, @3    ; инициализировать мл. байт значения таймера 
    st -@2, @5    ; установить флаг таймера - немедленный запуск таймера с новыми параметрами
    sei
;_set_timer_return:
.ENDMACRO

;==================================================================
;                   макрос _OCR0B_On_
;==================================================================
;  подключение OCR0A к выводу
;==================================================================
; Описание параметров макроса
; @0 - регистр РОН оператор регистра tccr0a  (например r16)
; @1 - регистр РОН содержащий бит флага tccr0a, 
;      подключающий OCR0B к выводу  (например r17)
;==================================================================
.MACRO  _OCR0A_On_
	in  @0, tccr0a
	ldi @1, 0x40
	or @0, @1		; подключить OCR0A к выводу
	out tccr0a, @0	; OCR0B подключен к выводу
.ENDMACRO

;==================================================================
;                   макрос _OCR0A_Off_
;==================================================================
;  отключение OCR0B от вывода
;==================================================================
; Описание параметров макроса
; @0 - регистр РОН оператор регистра tccr0a  (например r16)
; @1 - регистр РОН содержащий бит флага tccr0a, 
;      отключающий OCR0B к выводу  (например r17)
;==================================================================
.MACRO  _OCR0A_Off_
	in  @0, tccr0a
	ldi @1, 0xbf
	and @0, @1		; отключить OCR0A от вывода
	out tccr0a, @0	; OCR0B подключен к выводу
.ENDMACRO

;==================================================================
;                   макрос _OCR0B_On_
;==================================================================
;  подключение OCR0B к выводу
;==================================================================
; Описание параметров макроса
; @0 - регистр РОН оператор регистра tccr0a  (например r16)
; @1 - регистр РОН содержащий бит флага tccr0a, 
;      подключающий OCR0B к выводу  (например r17)
;==================================================================
.MACRO  _OCR0B_On_
	in  r16, tccr0a
	ldi r17, 0x10
	or r16, r17		; подключить OCR0B к выводу
	out tccr0a, r16	; OCR0B подключен к выводу
.ENDMACRO

;==================================================================
;                   макрос _OCR0B_Off_
;==================================================================
;  отключение OCR0B от вывода
;==================================================================
; Описание параметров макроса
; @0 - регистр РОН оператор регистра tccr0a  (например r16)
; @1 - регистр РОН содержащий бит флага tccr0a, 
;      отключающий OCR0B к выводу  (например r17)
;==================================================================
.MACRO  _OCR0B_Off_
	in  r16, tccr0a
	ldi r17, 0xef
	and r16, r17		; отключить OCR0B от вывода
	out tccr0a, r16	; OCR0B подключен к выводу
.ENDMACRO

;==================================================================
;                   макрос _MODE_INT0_
;==================================================================
;   задается разрешение от внешнего прерывания INT0
;==================================================================
; Описание параметров макроса
; @0 - регистр РОН (например r16)
; @1 - регистр РОН оператор регистра mcucr (например r17)
; @2 - номер режима INT0:
;      0 - по низкому уровню
;      1 - при любом изменении
;      2 - при спаде
;      3 - при фронте
;==================================================================
.MACRO _MODE_INT0_
    ldi @0, @2        ; @2 - режим прерывания от INT0 по нарастающему фронту
    in @1, mcucr
    or @1, @0
    out mcucr, @1     ; устанавливается режим от внешнего прерывания INT0
.ENDMACRO

;==================================================================
;                   макрос _SET_NUM_PCIE_
;=====================================================
;   задается номер прерывания PCIE
;=====================================================
; Описание параметров макроса
; @0 - регистр РОН (например r16)
; @1 - регистр РОН оператор регистра pcmsk (например r17)
; @2 - номер PCIE:
;      1 - PCI0
;      2 - PCI1
;      4 - PCI2
;      8 - PCI3
;   0x10 - PCI4
;   0x20 - PCI5
;==================================================================
.MACRO _SET_NUM_PCIE_
    ldi @0, @2        ; @2 - задается номер прерывания PCINT
    in @1, pcmsk
    or @1, @0
    out pcmsk, @1     ; устанавливается номер прерывания PCINT
.ENDMACRO

;==================================================================
;                   макрос _EN_EXTINT_
;==================================================================
;   задается разрешение от внешнего прерывания INT0
;==================================================================
; Описание параметров макроса
; @0 - регистр РОН (например r16)
; @1 - регистр РОН оператор регистра gimsk (например r17)
; @2 - флаги разрешенных прерываний:
;       0x20 - PCIE
;       0x40 - INT0
;       0x60 - оба
;==================================================================
.MACRO _EN_EXTINT_
    ldi @0, @2        ; @2 биты прерываний разрешенных от ЕХТINT
    in @1, gimsk
    or @1, @0
    out gimsk, @1     ; устанавливается разрешение от внешнего прерывания INT0
    in @1, gifr
    eor @1, @0
    out gifr, @1      ; сброс флагов прерываний установленных ранее   
.ENDMACRO


;==================================================================
;                   макрос _DIS_EXTINT_
;==================================================================
;   задается запрет от внешнего прерывания INT0
;==================================================================
; Описание параметров макроса
; @0 - регистр РОН (например r16)
; @1 - регистр РОН оператор регистра gimsk (например r17)
; @2 - флаги запрешенных прерываний:
;       0x20 - PCIE
;       0x40 - INT0
;       0x60 - оба
;==================================================================
.MACRO _DIS_EXTINT_
    ldi @0, @2        ; @2 биты прерываний разрешенных от ЕХТINT
    in @1, gimsk
    eor @1, @0
    out gimsk, @1     ; устанавливается разрешение от внешнего прерывания INT0
.ENDMACRO
