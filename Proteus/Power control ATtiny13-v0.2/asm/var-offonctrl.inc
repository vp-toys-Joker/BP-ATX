/*
 * var_offonctrl.asm
 *
 *  Created: 30.10.2019 13:48:31
 *   Author: vp
 */ 
;====================================================================
;                       VARIABLES
;====================================================================
.DSEG
.ORG 0x60
;fdel:       .byte 1 ; 1 - флаг четного прерывания или делителя частоты: 0 - четный (пропуск счета); 1 - нечетный (счет)
;==============================================================================================
;                  таймер номер 1 (например для звука)
;.ORG 0x61
timer01:  .byte 3	; +0 - флаг таймера: 0 - неактивный; 1- активный
				    ; +1 - время работы таймера (мл. байт слова)
				    ; +2 - время работы таймера (ст. байт слова)
;==============================================================================================
;                  таймер номер 2 (например для мигания светодиода)
;.ORG 0x64
timer02:.byte 3	; +0 - флаг таймера: 0 - неактивный; 1- активный
				    ; +1 - время работы таймера (мл. байт слова)
				    ; +2 - время работы таймера (ст. байт слова)
;==============================================================================================
;                  таймер номер 3 (например для ожидания события)
;.ORG 0x67
timer03: .byte 3	; +0 - флаг таймера: 0 - неактивный; 1- активный
				    ; +1 - время работы таймера (мл. байт слова)
				    ; +2 - время работы таймера (ст. байт слова)
;==============================================================================================
;                  таймер номер Z (например для дребезга кнопки)
;.ORG 0x?? - последняя запись структур таймера. Добавление записей таймеров должно осуществляться до этой записи
timer0Z:  .byte 3   ; +0 - флаг таймера: 0 - неактивный; 1- активный
                    ; +1 - время работы таймера (мл. байт слова)
                    ; +2 - время работы таймера (ст. байт слова)
;==============================================================================================
;                               Состояния и режимы
;==============================================================================================
;====================================================================
; state |                       0 - отключен                        |
;====================================================================
; mode  | Готовность | Ожидание включения | Индикация неисправности |
;       |  Ожидание  | (появление напряже-| (БП не запустился или   |
;       |  кнопки    |  ния)              | самопроизвольно отключ. |
;       |============================================================
;       |     0      |         1          |          2              |
;====================================================================
; state |                       1 - включен                         |
;====================================================================
; mode  | Готовность | Ожидание отключения| Индикация неисправности |
;       | Ожидание   |(пропадание напряже-| (БП не отключился)      |
;       | кнопки     | ния)               |                         |
;       |============================================================
;       |    0       |         1          |          2              |
;====================================================================
;state:    .byte 1    ; состояние: 0 - отключен; 1 - включен
;mode:     .byte 1    ; режим состояния
;button:   .byte 1    ; событие нажатия кнопки: 0 - нет события; 1 - была нажата и отжата.
;key_state:.byte 1    ; состояние обработчика нажатия кнопки: 
;                     ;     0 - ожидание: начальное значение - устанавл. обработчик key_process
;                     ;     1 - событие обработчика прерывания - произошло изменение входа INT0 - начало обработки дребезга контактов
;                     ;     2 - событие обработчика прерывания - обработка дребезга контактов и определение состояния кнопки
;                     ;         устанавл. обработчик key_process
;pwr_ok_event:.byte 1 ; событие изменения состояния контрольного сигнала PW_OK
;                     ;     0 - ожидание: нет события;
;                     ;     1 - событие - состояние изменилось
;pwr_ok_state:.byte 1    ; состояние входа контрольного сигнала PW_OK
                     ;     0 - нет напряжения;
                     ;     1 - есть напряжение
;snd_err_stat:.byte 1 ; звуковое статус: 0 - звучание; 1 - пауза.
;snd_err_mode:.byte 1 ; звуковой режим: 0 - отключен; 1 - БП не включился; 2 - БП самопроизвольно отключился
;==============================================================================================
;                                   Код ошибки
;==============================================================================================
; Коды ошибок:
; 0 - нет ошибки; 
; 1 - БП не запустился; 
; 2 - БП - не отключился; 
; 3 - БП самопроизвольно отключился
;==============================================================================================
;error:    .byte 1 
.ifdef _DEBUG_
shatter_count: .byte 1
shatter2_count: .byte 1
.endif
